// This file was generated from a template. Edit it to match your keyboard.
// See https://zmk.dev/docs/development/hardware-integration/new-shield for more instructions.

#include <behaviors.dtsi>
#include <dt-bindings/zmk/keys.h>

/ {
    // Define a default keymap here.
    // See https://zmk.dev/docs/development/hardware-integration/new-shield#default-keymap.
    keymap {
        compatible = "zmk,keymap";

        default_layer {
            bindings = <
                &kp D &kp F &kp J &kp K &kp C &kp M &kp RETURN
            >;
            sensor-bindings = <&inc_dec_kp W E &inc_dec_kp I O>;
        };
    };
};
